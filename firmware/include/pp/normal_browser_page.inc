static const char kNormalBrowserHtml[] = R"PPHTML(<!doctype html><meta charset="utf-8"><meta name="viewport" content="width=device-width,initial-scale=1"><title>Plonk & Play</title><style>:root{--b:#09111c;--p:#111c2b;--p2:#172437;--l:#2a394d;--t:#f4f6f8;--m:#9eacbd;--y:#ffd400}*{box-sizing:border-box}body{margin:0;background:var(--b);color:var(--t);font:15px system-ui}.s{max-width:1280px;margin:auto;padding:0 22px 30px}.top{height:78px;display:flex;align-items:center;gap:28px;border-bottom:1px solid var(--l)}.logo{font-size:27px;font-weight:950;font-style:italic}.logo b{color:var(--y)}nav{display:flex;gap:22px;flex:1}button{font:inherit}.nav,.link{background:none;border:0;color:var(--m);font-weight:700;cursor:pointer}.status{text-align:right;font-weight:900}.reason{font-size:12px;color:var(--m)}.hero{padding:48px 0 24px}.eye{color:var(--y);font-size:13px;font-weight:900;letter-spacing:.13em}.hero h1{font-size:44px;margin:8px 0}.muted{color:var(--m)}.grid{display:grid;grid-template-columns:1.3fr .7fr;gap:18px}.card{background:var(--p);border:1px solid var(--l);border-radius:12px;padding:20px}.btn{border:1px solid var(--l);background:var(--p2);color:var(--t);border-radius:7px;padding:10px 16px;font-weight:800;cursor:pointer}.primary{background:var(--y);border-color:var(--y);color:#111}.btn:disabled{opacity:.4}.big{width:100%;font-size:24px;padding:18px}.entries{display:grid;gap:8px}.entry{display:grid;grid-template-columns:80px 1fr;gap:12px;background:var(--p2);padding:12px;border-radius:8px}.lane{color:var(--y);font-weight:900}.modes{display:flex;gap:7px;flex-wrap:wrap;margin-bottom:20px}.mode.on{border-color:var(--y);color:var(--y)}.mode.off{opacity:.35}.form{display:flex;gap:14px;align-items:center;margin:13px 0}.form label{min-width:150px;color:var(--m)}input,select{background:#0c1623;border:1px solid var(--l);color:var(--t);padding:10px;border-radius:6px}.race{padding-top:22px}.pod{background:#050a10;border:1px solid #34455a;border-radius:20px 20px 8px 8px;padding:18px;text-align:center}.lamps{display:flex;justify-content:center;gap:13px}.lamp{width:42px;height:42px;border-radius:50%;background:#222;border:4px solid #101010}.red.on{background:#e63c3c;box-shadow:0 0 16px #e63c3c}.green.on{background:#43c768;box-shadow:0 0 16px #43c768}.podstate{font-weight:950;letter-spacing:.14em;margin-top:9px}.clock{font-size:64px;font-weight:950;text-align:center;padding:20px}.bar{display:flex;justify-content:space-between;align-items:center;margin:14px 0}.table{border:1px solid var(--l);border-radius:10px;overflow:hidden}.tr{display:grid;grid-template-columns:80px 1.5fr 1fr 1fr 1fr 1fr;align-items:center;min-height:54px;padding:0 14px;border-top:1px solid var(--l)}.th{color:var(--m);font-size:12px;font-weight:800}.practice .tr{grid-template-columns:1.7fr 1fr 1fr 1fr}.overlay{position:fixed;inset:0;background:#050a10cc;display:grid;place-items:center}.dialog{width:min(440px,90vw);background:var(--p);border:1px solid var(--l);border-radius:14px;padding:28px;text-align:center}.actions{display:flex;justify-content:center;gap:10px;flex-wrap:wrap}.notice{position:fixed;right:20px;bottom:20px;background:var(--p2);border:1px solid var(--l);padding:12px 16px;border-radius:8px}.result{display:grid;grid-template-columns:70px 1.3fr 1fr 1fr 1fr 1fr;gap:8px;padding:14px;border-top:1px solid var(--l)}.lease{position:fixed;left:20px;top:92px;z-index:20;background:var(--p);border:1px solid var(--l);border-radius:8px;padding:10px 14px;display:flex;gap:10px;align-items:center}.hide{display:none!important}@media(max-width:800px){nav{display:none}.grid{grid-template-columns:1fr}.tr{font-size:13px}}.devtab{position:fixed;right:0;top:45%;z-index:40;border-radius:7px 0 0 7px;background:var(--y);color:#111;border:0;padding:10px 7px;font-weight:950;cursor:pointer;writing-mode:vertical-rl}.devdrawer{position:fixed;right:0;top:0;bottom:0;width:390px;max-width:95vw;background:#0b1522;border-left:1px solid var(--l);z-index:50;overflow:auto;padding:14px;box-shadow:-12px 0 28px #0008}.devhead{position:sticky;top:0;background:#0b1522;display:flex;align-items:center;gap:10px;padding:6px 0 12px;z-index:2}.devhead b{flex:1}.live{color:var(--y);font-size:12px;letter-spacing:.12em}.devsec{border-top:1px solid var(--l);padding:12px 0}.devsec h3{font-size:12px;letter-spacing:.12em;color:var(--m);margin:0 0 9px}.devkv{display:grid;grid-template-columns:1fr 1.25fr;gap:5px 10px;font-size:13px}.devkv span:nth-child(odd){color:var(--m)}.devlane{background:var(--p);border:1px solid var(--l);border-radius:8px;padding:9px;margin:7px 0;font-size:13px}.devlane b{color:var(--y)}.devfeedback{min-height:18px;color:var(--m);font-size:12px;margin-top:7px}.devmore{font-size:12px;color:var(--m)}body.devopen .s{margin-right:390px}@media(max-width:900px){body.devopen .s{margin-right:auto}.devdrawer{width:min(390px,95vw)}}</style><div class="s"><header class="top" id="head"><div class="logo" id="logo"><b>P</b>&amp;<b>P</b></div><nav><button class="nav" id="setupNav">Race Setup</button><button class="nav" id="resultsNav">Results</button><button class="nav" id="trackNav">Track Setup</button><button class="nav" id="racersNav">Racers</button><button class="nav" id="settingsNav">Settings</button></nav><div><div class="status" id="status">CONNECTING</div><div class="reason" id="reason"></div></div></header><main id="app"></main></div><div id="controlLease" class="lease hide"></div><div id="overlay"></div><div id="notice" class="notice hide"></div><button id="devTab" class="devtab">DEV</button><aside id="devDrawer" class="devdrawer hide" aria-label="Developer diagnostics"><div class="devhead"><b>DEVELOPER</b><span class="live">LIVE</span><button class="link" id="devClose">×</button></div><section class="devsec"><h3>P&amp;P STATE</h3><div id="devState" class="devkv"></div></section><section class="devsec"><h3>LANES</h3><div id="devLanes"></div></section><section class="devsec"><h3>TEST INPUTS</h3><div>SIMULATED PASSAGE</div><div class="actions"><button class="btn" id="devL1">PASS L1</button><button class="btn" id="devL2">PASS L2</button></div><div id="devFixture" class="devfeedback"></div></section><section class="devsec"><h3>EVENTS / HEALTH</h3><div id="devFact" class="devlane">Latest fact —</div><div id="devHealth" class="devkv"></div><details class="devmore"><summary>MORE</summary><div id="devHealthMore" class="devkv"></div></details></section></aside><script>function overtimeClock(us){const tenths=Math.max(0,Math.floor(Number(us||0)/100000));const totalSeconds=Math.floor(tenths/10);const minutes=Math.floor(totalSeconds/60);const seconds=totalSeconds-minutes*60;return '+'+String(minutes).padStart(2,'0')+':'+String(seconds).padStart(2,'0')+'.'+String(tenths-totalSeconds*10)}let S=null,P=null,C=null,V='home',connectionState='CONNECTING',busy=false,corr=1,polling=false,pollDirty=false,selectedHistorySequence=null,resultData=null,resultDataKey=null,resultDataHistorySequence=null,detailsData=null,detailsDataKey=null,historyData=null,practiceData=null,viewPinned=false,lastLifecycle=null,lastSseNotification=null,activeLatencyTrace=null,displayedLapByEntry={};let setupRenderedRevision=null,proposalEpoch=null,retiredProposalEpochs=new Set(),setupEpochToken=0;const $=q=>document.querySelector(q),A=$('#app');const sec=u=>u?`${(+u/1e6).toFixed(2)} s`:'—',lapWord=n=>`${Number(n||0)} lap${Number(n||0)===1?'':'s'}`,clock=u=>{let n=Math.max(0,Math.floor(+u/1e6));return`${String(Math.floor(n/60)).padStart(2,'0')}:${String(n%60).padStart(2,'0')}`};const requestTimeoutMs=4000;const viewStorageKey='pp.normal.view';const viewNames=new Set(['home','setup','track','racers','settings','diagnostics','network','results','details','history','practice']);function rememberView(){try{sessionStorage.setItem(viewStorageKey,V)}catch(_){}}function restoreView(){try{const v=sessionStorage.getItem(viewStorageKey);if(viewNames.has(v))V=v}catch(_){}}function markOffline(){connectionState='OFFLINE';const status=$('#status'),reason=$('#reason');if(status)status.textContent='OFFLINE';if(reason)reason.textContent='Controller unavailable · Trying to reconnect';for(const id of ['start','change','networkScan','networkConnect','networkDisconnect','networkForget','developmentToggle','takeControl','allowControl','keepControl']){const control=$('#'+id);if(control)control.disabled=true}const overlay=$('#overlay');if(overlay)overlay.innerHTML='<div class="overlay"><div class="dialog"><h2>Controller unavailable</h2><p class="muted">Trying to reconnect…</p></div></div>'}function markSynchronised(){connectionState='SYNCHRONISED';const overlay=$('#overlay');if(overlay)overlay.innerHTML=''}let diagnosticTraceSequence=1,diagnosticPresentationTraceId=0,diagnosticPresentationCorrelation=0,diagnosticPresentationOperation='',diagnosticPresentationTracePending=false;function diagnosticTraceId(){const v=(Date.now()*65537+diagnosticTraceSequence++)%9007199254740991;return v||1}function diagnosticOperationForPath(path){if(path.includes('restart-race'))return 'RESTART_RACE';if(path.includes('start'))return 'START';if(path.includes('setup'))return 'SETUP';if(path.includes('pause'))return 'PAUSE';if(path.includes('resume'))return 'RESUME';if(path.includes('practice-again'))return 'PRACTICE_AGAIN';if(path.includes('race-again'))return 'RACE_AGAIN';if(path.includes('end-race'))return 'END_RACE';if(path.includes('end-session'))return 'END_SESSION';if(path.includes('skip-finish'))return 'SKIP_FINISH_DISPLAY';return 'UNKNOWN'}function diagnosticAction(operation,correlation,traceId){try{fetch('/diag/browser',{method:'POST',headers:{'Content-Type':'application/json'},body:JSON.stringify({operation,correlationId:correlation,diagnosticTraceId:traceId}),keepalive:true}).catch(()=>{})}catch(_){}}function diagnosticObservation(kind,extra={}){const d={kind,operation:extra.operation||(diagnosticPresentationTracePending?diagnosticPresentationOperation:''),diagnosticTraceId:Number(extra.traceId||(diagnosticPresentationTracePending?diagnosticPresentationTraceId:0)||0),correlationId:Number(extra.correlationId||(diagnosticPresentationTracePending?diagnosticPresentationCorrelation:0)||0),revision:Number(extra.revision||0),eventId:Number(extra.eventId||0),detail:Number(extra.detail||0),lifecycle:extra.lifecycle||'',sessionMode:extra.sessionMode||'',phase:extra.phase||''};try{fetch('/diag/browser-observation',{method:'POST',headers:{'Content-Type':'application/json'},body:JSON.stringify(d),keepalive:true}).catch(()=>{})}catch(_){}}async function G(p){const controller=new AbortController();const timeout=setTimeout(()=>controller.abort(),requestTimeoutMs);try{let r=await fetch(p,{cache:'no-store',signal:controller.signal});if(r.status===204)return null;if(!r.ok){let e=Error(r.status);e.status=r.status;throw e}return r.json()}finally{clearTimeout(timeout)}}function name(m){return m==='OPEN_PRACTICE'?'OPEN PRACTICE':m==='ENDURANCE'?'ENDURANCE':m==='TIMED_STAGE'?'TIMED STAGE':m==='DRAG'?'DRAG':'LAP RACE'}function fp(x){return x==='COMPLETE_CURRENT_LAP'?1:x==='COMPLETE_FULL_RACE_DISTANCE'?2:0}function pe(){return(P?.entries||[]).map(e=>`<div class="entry"><div class="lane">LANE ${e.lane}</div><b>Racer ${e.mugId??'—'}</b></div>`).join('')}function readyText(){let c=P?.readinessContext?.code;return c==='INVALID_RACE_SETUP'?'Race setup needs attention':c==='CAPABILITY_UNAVAILABLE'?'Mode unavailable':c==='LIFECYCLE_NOT_STARTABLE'?'P&P is not ready to start':''}function controlLeaseResultText(v){return v==='ACCEPTED'?'Control granted':v==='REFUSED'?'Takeover refused':v==='PENDING'?'Takeover requested':v==='ALREADY_PENDING'?'Another takeover is pending':''}
async function takeControl(){try{let r=await fetch('/request/take-control',{method:'POST',headers:{'Content-Type':'application/json'}});let j=await r.json();note(controlLeaseResultText(j.result)||'Control request rejected.');await poll('reconnect');if(j.result==='PENDING'){let attempts=0;const watch=async()=>{if(++attempts>20)return;await poll('reconnect');if(C?.takeoverPending&&C?.takeoverRequestedByThis)setTimeout(watch,1000)};setTimeout(watch,1000)}}catch(_){note('Control request failed.');}}
async function answerTakeover(path){try{await fetch(path,{method:'POST',headers:{'Content-Type':'application/json'}});await poll('reconnect')}catch(_){note('Control response failed.');}}
function renderControlLease(){const e=$('#controlLease');if(!e||!C)return;let h='';if(C.takeoverPending&&C.isMaster){h='<b>Another device is requesting control.</b><button class="btn primary" id="allowControl">ALLOW</button><button class="btn" id="keepControl">KEEP CONTROL</button>'}else if(C.takeoverPending&&C.takeoverRequestedByThis){h='<span>TAKEOVER REQUESTED</span>'}else if(!C.isMaster){h='<button class="btn" id="takeControl">TAKE CONTROL</button>'}e.innerHTML=h;e.classList.toggle('hide',!h);if($('#takeControl'))$('#takeControl').onclick=takeControl;if($('#allowControl'))$('#allowControl').onclick=()=>answerTakeover('/request/take-control/allow');if($('#keepControl'))$('#keepControl').onclick=()=>answerTakeover('/request/take-control/keep')}function header(){renderControlLease();if(connectionState!=='SYNCHRONISED'){return}let active=S&&(['STARTING','RACING','PAUSED','RESTARTING'].includes(S.lifecycle)||S.finishDisplay?.active);$('#head').classList.toggle('hide',!!active);if(!active){if(S?.lifecycle==='FINISHED'&&!S.finishDisplay?.active&&(V==='results'||S.resultSealed)){$('#status').textContent='RESULTS';$('#reason').textContent='';return}$('#status').textContent=P?.startable?(canControl()?'READY':'RACE DIRECTOR REQUIRED'):'NOT READY';$('#reason').textContent=P?.startable?'':readyText()}}function canControl(){return C?.isMaster}async function makeDirector(){await takeControl();render()}function home(){let d=P.mode==='ENDURANCE'?`${P.durationMinutes} MINUTES`:P.mode==='OPEN_PRACTICE'?'OPEN SESSION':`${P.lapTarget} LAPS`;A.innerHTML=`<section class="hero"><div class="eye">${P.startable?'READY TO RACE':'NOT READY'}</div><h1>${name(P.mode)}</h1><div class="muted">${d}</div></section><div class="grid"><section class="card"><h2>Race Entries</h2><div class="entries">${pe()}</div></section><section class="card">${canControl()?`<button class="btn primary big" id="start">${busy?'STARTING…':'START'}</button>`:'<button class="btn primary big" id="makeDirector">MAKE RACE DIRECTOR</button>'}<button class="link" id="change">Change Race</button><p class="muted">${P.startable?'':'FIX · '+readyText()}</p></section></div>`;if($('#start')){$('#start').disabled=busy||setupRunning||!!setupDesired||!P.startable;$('#start').onclick=()=>req('/request/start',{})}if($('#makeDirector'))$('#makeDirector').onclick=makeDirector;$('#change').onclick=()=>{V='setup';render()}}let setupDesired=null,setupRunning=false,setupError='',numericTimers={};
function proposalCandidate(p){return{mode:p?.mode||'LAP_RACE',lapTarget:Number(p?.lapTarget||0),durationMinutes:Number(p?.durationMinutes||1),finishPolicy:fp(p?.finishBehaviour)}}
function candidateEqual(a,b){return !!a&&!!b&&a.mode===b.mode&&Number(a.lapTarget)===Number(b.lapTarget)&&Number(a.durationMinutes)===Number(b.durationMinutes)&&Number(a.finishPolicy)===Number(b.finishPolicy)}
function displayCandidate(){return setupDesired||proposalCandidate(P)}
function proposalFromCandidate(c){return{mode:c.mode,lapTarget:Number(c.lapTarget||0),durationMinutes:Number(c.durationMinutes||1),finishPolicy:Number(c.finishPolicy||0),proposalRevision:Number(P?.proposalRevision||0)}}function refreshSetupStart(){const b=$('#start');if(!b)return;b.disabled=busy||setupRunning||!!setupDesired||!C?.isMaster||!P?.startable;b.textContent=setupRunning||setupDesired?'UPDATING…':'START'}
function applyProposal(next){
 if(!next)return false;
 const nextEpoch=String(next.controllerEpoch??'');
 const currentEpoch=proposalEpoch===null?null:String(proposalEpoch);
 if(retiredProposalEpochs.has(nextEpoch))return false;
 if(P&&currentEpoch===nextEpoch){
  const nr=Number(next.proposalRevision||0),cr=Number(P.proposalRevision||0);
  if(nr<cr)return false;
 }else if(P&&currentEpoch!==nextEpoch){
  retiredProposalEpochs.add(currentEpoch);
  setupDesired=null;
  setupError='';
  setupRenderedRevision=null;
  setupEpochToken++;
  for(const key of Object.keys(numericTimers||{})){if(numericTimers[key])clearTimeout(numericTimers[key]);numericTimers[key]=null}
 }
 P=next;
 proposalEpoch=nextEpoch;
 return true
}
async function freshProposal(){try{const next=await G('/proposal');return applyProposal(next)?next:P}catch(e){return null}}
async function waitSetupResult(id){for(let i=0;i<50;i++){await new Promise(r=>setTimeout(r,100));try{const x=await G('/request-result?correlationId='+id);if(x)return x}catch(e){}}return{result:'REJECTED',reason:'REQUEST_TIMEOUT'}}
async function submitSetupCandidate(candidate,revision){const id=corr++;const traceId=diagnosticTraceId();diagnosticAction('SETUP',id,traceId);let r;try{r=await fetch('/request/setup',{method:'POST',headers:{'Content-Type':'application/json'},body:JSON.stringify({correlationId:id,diagnosticTraceId:traceId,mode:candidate.mode,lapTarget:Number(candidate.lapTarget||0),durationMinutes:Number(candidate.durationMinutes||0),finishPolicy:Number(candidate.finishPolicy||0),proposalRevision:Number(revision||0)})})}catch(e){return{result:'REJECTED',reason:'REQUEST_FAILED'}}if(r.status!==202)return{result:'REJECTED',reason:'REQUEST_NOT_ACCEPTED'};return waitSetupResult(id)}
async function drainSetup(){if(setupRunning)return;setupRunning=true;setupError='';if(V!=='setup')render();let restoreSetup=false;const epochToken=setupEpochToken;try{while(setupDesired&&epochToken===setupEpochToken){const desired={...setupDesired};const base=await freshProposal();if(epochToken!==setupEpochToken||!base)break;const candidate={...proposalCandidate(base),...desired};const outcome=await submitSetupCandidate(candidate,base.proposalRevision);if(epochToken!==setupEpochToken)break;const accepted=outcome.result==='ACCEPTED';const latest=await freshProposal();if(epochToken!==setupEpochToken)break;if(accepted&&latest&&candidateEqual(proposalCandidate(latest),candidate)){if(setupDesired&&candidateEqual(setupDesired,desired))setupDesired=null;setupError='';if(V==='setup'&&S?.lifecycle==='READY')setupRenderedRevision=Number(latest.proposalRevision||0)}else if(!accepted){if(latest)setupDesired=null;setupError=outcome.reason||'P&P rejected that setup change';if(setupDesired&&candidateEqual(setupDesired,desired))setupDesired=null;restoreSetup=true;note(setupError)}else{if(latest&&setupDesired&&candidateEqual(setupDesired,desired))setupDesired=null;setupError='P&P proposal changed; retrying the current setup';}if(restoreSetup||V!=='setup'||S?.lifecycle!=='READY')render();restoreSetup=false}}finally{setupRunning=false;refreshSetupStart();if(V!=='setup'||S?.lifecycle!=='READY')render()}}function change(patch,defer){const base=displayCandidate();const next={...base,...patch};if(setupDesired&&candidateEqual(setupDesired,next)){if(!defer&&!setupRunning)drainSetup();return}setupDesired=next;setupError='';if(V==='setup'&&!patch.mode){const b=$('#start');if(b){b.disabled=true;b.textContent='UPDATING…'}}else render();if(!defer)drainSetup()}
function mb(m,l){let x=(P.supportedModes||[]).find(x=>x.mode===m),ok=!!x?.available;return`<button class="btn mode ${P.mode===m?'on':''} ${ok?'':'off'}" data-m="${m}" ${ok?'':'disabled'}>${l}${ok?'':' · Not yet available'}</button>`}function setup(){const d=displayCandidate();A.innerHTML=`<section class="hero"><div class="eye">RACE SETUP</div><h1>What are we racing?</h1></section><section class="card"><div class="modes">${mb('LAP_RACE','Lap Race')}${mb('OPEN_PRACTICE','Practice')}${mb('ENDURANCE','Endurance')}${mb('TIMED_STAGE','Timed Stage')}${mb('DRAG','Drag')}</div><div id="fields"></div><h2>Race Entries</h2><div class="entries">${pe()}</div><div class="actions"><button class="btn" id="back">Back</button><button class="btn primary" id="start">${setupRunning||setupDesired?'UPDATING…':'START'}</button></div>${setupRunning||setupDesired?'<p class="muted">Updating race setup…</p>':''}${setupError?`<p class="muted">${setupError}</p>`:''}</section>`;document.querySelectorAll('[data-m]:not(:disabled)').forEach(b=>b.onclick=()=>change({mode:b.dataset.m}));$('#back').onclick=()=>{V='home';render()};$('#start').disabled=busy||setupRunning||!!setupDesired||!C?.isMaster||!P.startable;$('#start').onclick=()=>req('/request/start',{});fields();setupRenderedRevision=Number(P?.proposalRevision||0)}function numericValue(v){let n=Number(v);return Number.isFinite(n)?Math.max(1,Math.min(999,Math.round(n))):null}
function bindNumeric(id,key){const el=$('#'+id);if(!el)return;let commitTimer=numericTimers[id];const commit=()=>{if(commitTimer){clearTimeout(commitTimer);commitTimer=null;numericTimers[id]=null}const raw=String(el.value??'').trim();if(!raw)return;const n=numericValue(raw);if(n===null)return;el.value=String(n);change({[key]:n})};el.oninput=()=>{if(commitTimer)clearTimeout(commitTimer);const raw=String(el.value??'').trim();if(raw){const n=numericValue(raw);if(n!==null)change({[key]:n},true)}commitTimer=setTimeout(commit,450);numericTimers[id]=commitTimer};el.onchange=commit;el.onblur=commit;el.onkeydown=e=>{if(e&&e.key==='Enter'){if(e.preventDefault)e.preventDefault();commit()}};el.addEventListener('wheel',e=>{if(!e||!e.deltaY)return;if(e.preventDefault)e.preventDefault();if(e.deltaY<0)el.stepUp();else el.stepDown();el.oninput()},{passive:false})}function fields(){const d=displayCandidate();let b=$('#fields');if(d.mode==='OPEN_PRACTICE')b.innerHTML='<div class="form"><label>Practice type</label><b>OPEN</b></div><p class="muted">No time limit. End the session when finished.</p>';else if(d.mode==='ENDURANCE')b.innerHTML=`<div class="form"><label>Duration</label><input id="duration" type="number" min="1" max="999" step="1" value="${d.durationMinutes}"> minutes</div><div class="form"><label>At zero</label><select id="finish"><option value="0" ${Number(d.finishPolicy)===0?'selected':''}>Stop at zero</option><option value="1" ${Number(d.finishPolicy)===1?'selected':''}>Finish current lap</option></select></div>`;else b.innerHTML=`<div class="form"><label>Race distance</label><input id="laps" type="number" min="1" max="999" step="1" value="${d.lapTarget}"> laps</div><div class="form"><label>Winner finishes</label><select id="finish"><option value="0" ${Number(d.finishPolicy)===0?'selected':''}>All stop when winner finishes</option><option value="1" ${Number(d.finishPolicy)===1?'selected':''}>Others finish current lap</option><option value="2" ${Number(d.finishPolicy)===2?'selected':''}>Others complete total laps</option></select></div>`;bindNumeric('duration','durationMinutes');bindNumeric('laps','lapTarget');if($('#finish'))$('#finish').onchange=()=>change({finishPolicy:+$('#finish').value})}function pod(){let p=S.startPresentation||{},n=5,lit=+p.redLightsLit||0,phase=p.phase||'NONE',green=!!p.green;let rs=Array.from({length:n},(_,i)=>{let c=green?'green on':i<lit?'red on':'';return`<i class="lamp ${c}"></i>`}).join(''),label=S.finishDisplay?.active?'FINISHED':phase==='RESUME_COUNTDOWN'?'RESUMING':phase==='COUNTDOWN'?'STARTING':phase==='GO'?'GO':S.lifecycle;return`<div class="pod"><div class="lamps">${rs}</div><div class="podstate">${label}</div></div>`}function gap(e){if(e.gapKind==='TIME')return`+${(+e.gapTimeUs/1e6).toFixed(2)} s`;if(e.gapKind==='LAPS')return`+${+e.gapLaps} L`;return'—'}function race(){let pr=S.sessionMode==='OPEN_PRACTICE',en=S.sessionMode==='ENDURANCE';const resumeCountdown=S.startPresentation?.phase==='RESUME_COUNTDOWN';const displayDuration=S.lifecycle==='STARTING'&&en&&!resumeCountdown&&Number(S.durationMinutes)>0?Number(S.durationMinutes)*60000000:S.remainingDuration;let rows=(S.entries||[]).map(e=>pr?`<div class="tr"><b>Lane ${e.lane} · Racer ${e.mugId??'—'}</b><div>${e.laps}</div><div>${sec(e.lastLapTime)}</div><div>${sec(e.bestLapTime)}</div></div>`:`<div class="tr"><div>${e.position||'—'}</div><b>Lane ${e.lane} · Racer ${e.mugId??'—'}</b><div>${en?e.laps:`${e.laps} / ${S.lapTarget}`}</div><div>${sec(e.lastLapTime)}</div><div>${sec(e.bestLapTime)}</div><div>${gap(e)}</div></div>`).join('');let th=pr?'<div class="tr th"><div>LANE / RACER</div><div>LAPS</div><div>LAST</div><div>BEST</div></div>':'<div class="tr th"><div>POSITION</div><div>LANE / RACER</div><div>'+(en?'LAPS':'PROGRESS')+'</div><div>LAST</div><div>BEST</div><div>GAP</div></div>';A.innerHTML=`<section class="race ${pr?'practice':''}">${pod()}${en?`<div class="clock">${clock(displayDuration)}</div>`:''}<div class="bar"><b>${pr?'OPEN PRACTICE':en?'ENDURANCE · '+(S.finishBehaviour==='COMPLETE_CURRENT_LAP'?'FINISH CURRENT LAP':'STOP AT ZERO'):'LAP RACE'}</b><div>${S.lifecycle==='RACING'&&!S.finishDisplay?.active?'<button class="btn" id="pause">'+(busy?'PAUSING…':'PAUSE')+'</button>':''}${S.finishDisplay?.active?'<button class="btn primary" id="skip">RESULTS ›</button>':''}</div></div><div class="table">${th}${rows}</div></section>`;if(en&&S.finishBehaviour==='COMPLETE_CURRENT_LAP'&&Number(S.overtime||0)>0){A.insertAdjacentHTML('beforeend','<div class="status">Overtime: '+overtimeClock(S.overtime)+'</div>');}if($('#pause'))$('#pause').onclick=()=>req('/request/pause');if($('#skip'))$('#skip').onclick=()=>req('/request/skip-finish-display')}
function paused(){const practice=S.sessionMode==='OPEN_PRACTICE';race();$('#overlay').innerHTML=`<div class="overlay"><div class="dialog"><h2>RACE PAUSED</h2><div class="actions"><button class="btn primary" id="resume">RESUME</button><button class="btn" id="restart">RESTART</button>${practice?'<button class="btn" id="endPractice">END PRACTICE</button>':'<button class="btn" id="abandon">ABANDON</button>'}</div></div></div>`;$('#resume').onclick=()=>req('/request/resume');$('#restart').onclick=()=>destruct('/request/restart-race','/request/restart-race/confirm','Restart race');if($('#endPractice'))$('#endPractice').onclick=()=>req('/request/end-session');if($('#abandon'))$('#abandon').onclick=()=>destruct('/request/end-race','/request/end-race/confirm','Abandon race')}async function destruct(a,b,l){if(!confirm(`${l}?`))return;let id=corr++,traceId=diagnosticTraceId();diagnosticAction(diagnosticOperationForPath(b),id,traceId);let r=await fetch(a,{method:'POST',headers:{'Content-Type':'application/json'},body:JSON.stringify({correlationId:id,diagnosticTraceId:traceId})});if(!r.ok)return note(`${l} unavailable.`);r=await fetch(b,{method:'POST',headers:{'Content-Type':'application/json'},body:JSON.stringify({correlationId:id,diagnosticTraceId:traceId})});if(r.status===202)await wait(id)}function resultTimingPending(r){return r?.mode==='LAP_RACE'&&(r.entries||[]).some(e=>Number(e.classifiedLaps||0)>0&&Number(e.bestLap||0)>0&&!(Number(e.finishDurationUs||0)>0))}
function renderResults(r){
 const endurance=r.mode==='ENDURANCE';
 const behaviour=r.finishBehaviour==='COMPLETE_CURRENT_LAP'?'Finish current lap':r.finishBehaviour==='COMPLETE_FULL_RACE_DISTANCE'?'Complete race distance':'Stop at zero';
 const rows=(r.entries||[]).map(e=>{
  const classified=Number(e.classifiedLaps||0);
  const progress=r.mode==='LAP_RACE'&&Number(r.lapTarget||0)?`${classified} / ${Number(r.lapTarget)}`:`${lapWord(Number(e.laps||0))} · ${classified} classified`;
  const time=e.finishDurationUs?sec(e.finishDurationUs):'—';
  const gap=Number(e.lapsBehind||0)?`+${Number(e.lapsBehind)} ${Number(e.lapsBehind)===1?'lap':'laps'}`:'—';
  return `<div class="result"><b>${e.tied?'=':''}${e.rank}</b><b>Racer ${e.mugId??'—'} · Lane ${e.lane}</b><div>${progress}${e.lapPenalty?' · penalty '+e.lapPenalty:''}</div><div>${time}</div><div>${sec(e.bestLap)}</div><div>${gap}</div></div>`;
 }).join('');
 const session=endurance
  ? `<div class="muted">${r.durationMinutes} min · ${behaviour}${r.overtime?` · Overtime ${overtimeClock(r.overtimeUs)}`:''}</div>`
  : `<div class="muted">Fastest Lap · ${sec(r.fastestLap)}</div>`;
 A.innerHTML=`<section class="hero"><div class="eye">RESULTS</div><h1>${name(r.mode)}</h1>${session}</section><section class="card"><div class="result muted"><div>POSITION</div><div>LANE/RACER</div><div>PROGRESS</div><div>TIME</div><div>BEST</div><div>GAP</div></div>${rows}<div class="actions"><button class="btn" id="details">DETAILS</button><button class="btn" id="history">HISTORY</button>${selectedHistorySequence?'':'<button class="btn primary" id="again">RACE AGAIN</button>'}</div><div id="extra"></div></section>`;
 if($('#again'))$('#again').onclick=()=>req('/request/race-again');
 $('#details').onclick=()=>{detailsData=null;detailsDataKey=null;V='details';render()};
 $('#history').onclick=()=>{historyData=null;V='history';render()}
}
async function results(){
 let key=selectedHistorySequence||0;
 if(!selectedHistorySequence&&S?.lifecycle==='FINISHED'&&!S?.persistenceFault&&(!Number(S?.historySequence||0)||S?.persistencePending)){
  A.innerHTML='<section class="hero"><div class="eye">RESULTS</div><h1>Saving result…</h1><div class="muted">Preparing the committed result and lap times.</div></section>';
  return;
 }
 if(resultData&&resultDataKey===key){
  if(!resultTimingPending(resultData)){renderResults(resultData);return}
  resultData=null;resultDataKey=null;resultDataHistorySequence=null;
 }
 let q=selectedHistorySequence?`?sequence=${key}`:'';
 try{
  let r=null;
  for(let attempt=0;attempt<8;attempt++){
   r=await G('/results'+q);
   if(!resultTimingPending(r)||attempt===7)break;
   await new Promise(resolve=>setTimeout(resolve,125));
  }
  if(!r?.sealed){resultData=null;resultDataKey=null;V='home';return home()}
  resultData=r;resultDataKey=key;resultDataHistorySequence=Number(S?.historySequence||0);renderResults(r)
 }catch(e){resultData=null;resultDataKey=null;if(V==='results'){V='home';note(e.status===261?'No completed result is available.':`Results unavailable (HTTP ${e.status||'error'}).`);home()}}
}
function simpleView(title,body){if(title==='Settings'){return settingsPage()}A.innerHTML=`<section class="hero"><div class="eye">${title.toUpperCase()}</div><h1>${title}</h1></section><section class="card"><p class="muted">${body}</p></section>`}
 let networkRefreshTimer=0,networkRefreshDeadline=0,networkConnectPendingUntil=0,networkScanPendingUntil=0,networkDraftSsid='',networkDraftPassword='',networkDraftActive=false,networkObservedControl=null;
 function networkFormEditing(){const active=document.activeElement;return !!active&&(active.id==='networkSsid'||active.id==='networkPassword')}
 function scheduleNetworkRefresh(scanRunning,staConnecting,force){
   if(force)networkRefreshDeadline=Date.now()+15000;
  if(networkRefreshTimer){clearTimeout(networkRefreshTimer);networkRefreshTimer=0}
   if(scanRunning||staConnecting||Date.now()<networkRefreshDeadline){
    networkRefreshTimer=setTimeout(()=>{networkRefreshTimer=0;if($('#networkScan'))networkPage()},500)
  }
}
async function networkPage(force=false){
  V='network';rememberView();viewPinned=true;
  const existingSsid=$('#networkSsid'),existingPassword=$('#networkPassword');
  if(existingSsid){networkDraftSsid=existingSsid.value;networkDraftPassword=existingPassword?.value||'';networkDraftActive=true}
  let n;
  try{n=await G('/network/status')}catch(e){n=null}
  const v=n||{},ap=v.ap||{},sta=v.sta||{},mdns=v.mdns||{},scan=v.scan||{},networks=scan.networks||[];
  if(scan.state==='COMPLETE'||scan.state==='UNAVAILABLE')networkScanPendingUntil=0;
  const scanPending=Date.now()<networkScanPendingUntil,scanBusy=!!scan.running||scan.state==='RUNNING'||scanPending;
  const control=!!C?.isMaster;
  if(networkObservedControl!==control){networkObservedControl=control;diagnosticObservation('network_control_state',{detail:control?1:0});}
  const rows=networks.map((x,i)=>`<div class="devlane network-row" role="button" tabindex="0" data-network-index="${i}"><b>${x.ssid||'(hidden)'}</b><div class="muted">${x.rssi} dBm · ${x.secure?'secured':'open'}</div></div>`).join('')||'<p class="muted">No scan results.</p>';
   const scanFeedback=scanBusy?'Scanning for available networks…':scan.state==='UNAVAILABLE'?'Scan unavailable. Try again.':scan.count>=0?`${scan.count} network${scan.count===1?'':'s'} found.`:'Press SCAN to search.';
  const connectPending=Date.now()<networkConnectPendingUntil&&!sta.connected&&(!sta.lastFailure||sta.lastFailure==='NONE');
   const staState=connectPending?'CONNECTING':(sta.state|| (sta.connected?'CONNECTED':'DISCONNECTED'));
  if(!force&&networkFormEditing()){scheduleNetworkRefresh(scanBusy,sta.state==='CONNECTING'||connectPending,false);return}
  const reconnectButton=sta.configured&&!sta.connected?`<button class="btn primary" id="networkReconnect" ${control?'':'disabled'}>RECONNECT</button>`:'';
  const disconnectButton=sta.connected?`<button class="btn" id="networkDisconnect" ${control?'':'disabled'}>DISCONNECT</button>`:'';
  const configureLabel='CONNECT';
  A.innerHTML=`<section class="hero"><div class="eye">ADVANCED · DIAGNOSTICS · NETWORK</div><h1>Network</h1><p class="muted">The factory P&amp;P network remains available for racing.</p></section><section class="card"><h3>P&amp;P AP</h3><p class="muted">${ap.started?'Available':'Unavailable'} · ${ap.ssid||'Plonk-and-Play'} · ${ap.ip||'—'} · ${ap.clients||0} clients</p><h3>External Wi-Fi</h3><p class="muted">${sta.configured?`Remembered network: ${sta.ssid||'configured'}`:'No network configured'} · ${staState}${sta.ip&&sta.connected?` · ${sta.ip}`:''}</p><p class="muted">${mdns.started?`mDNS: ${mdns.host}`:'mDNS unavailable'}${sta.reconnectSuppressed?' · reconnect suppressed until Connect or reboot':''}</p><div class="form"><label for="networkSsid">SSID</label><input id="networkSsid" autocomplete="off" value="${sta.ssid||''}"></div><div class="form"><label for="networkPassword">Password for ${configureLabel.toLowerCase()}</label><input id="networkPassword" type="password" autocomplete="new-password" value=""></div><div class="actions">${reconnectButton}<button class="btn primary" id="networkConnect" ${control?'':'disabled'}>${configureLabel}</button>${disconnectButton}<button class="btn" id="networkForget" ${control?'':'disabled'}>FORGET NETWORK</button></div><p class="muted">${control?'Control lease: this Browser':'Mutating network settings requires the controlling SMUG/Race Director lease.'}</p><h3>Available networks</h3><button class="btn" id="networkScan" ${scanBusy?'disabled':''}>${scanBusy?'SCANNING…':'SCAN'}</button><p id="networkScanFeedback" class="muted">${scanFeedback}</p><div id="networkResults">${rows}</div><div class="actions"><button class="btn" id="networkBack">BACK</button></div></section>`;
  const ssidInput=$('#networkSsid'),passwordInput=$('#networkPassword');
  if(networkDraftActive){ssidInput.value=networkDraftSsid;passwordInput.value=networkDraftPassword}
  ssidInput.oninput=()=>{networkDraftActive=true;networkDraftSsid=ssidInput.value};
  passwordInput.oninput=()=>{networkDraftActive=true;networkDraftPassword=passwordInput.value};
  $('#networkBack').onclick=()=>diagnosticsPage();
  $('#networkScan').onclick=async()=>{let r;try{r=await fetch('/network/scan',{method:'POST'})}catch(e){networkScanPendingUntil=0;note('Scan unavailable.');await networkPage(true);return}let outcome={};try{outcome=await r.json()}catch(e){}if(!r.ok||outcome.accepted===false){networkScanPendingUntil=0;note('Scan request rejected.');await networkPage(true);return}networkScanPendingUntil=Date.now()+15000;note('Scanning for available networks…');await networkPage(true);scheduleNetworkRefresh(true,sta.state==='CONNECTING',true)};
  document.querySelectorAll('.network-row').forEach(row=>{const choose=()=>{const ssid=networks[Number(row.dataset.networkIndex)]?.ssid||'';networkDraftActive=true;networkDraftSsid=ssid;ssidInput.value=ssid;passwordInput.focus();note(ssid?`Selected ${ssid}. Enter the password and press CONNECT.`:'Hidden network selected. Enter the SSID and password.');};row.onclick=choose;row.onkeydown=e=>{if(e.key==='Enter'||e.key===' '){e.preventDefault();choose()}}});
   const submitNetworkConnect=async(e)=>{if(e)e.preventDefault();const button=$('#networkConnect');diagnosticObservation('network_reconfigure_click',{detail:button&&!button.disabled?1:0});if(!button||button.disabled)return;const ssid=ssidInput.value;const password=passwordInput.value;if(!ssid){note('Enter or select an SSID.');return}networkDraftActive=true;networkDraftSsid=ssid;networkDraftPassword='';button.disabled=true;const r=await fetch('/network/connect',{method:'POST',headers:{'Content-Type':'application/json','Accept':'application/json'},body:JSON.stringify({ssid:ssid,password:password})});passwordInput.value='';let outcome={};try{outcome=await r.json()}catch(e){}if(r.ok&&outcome.accepted!==false){networkConnectPendingUntil=Date.now()+15000;note('Connecting…')}else{networkConnectPendingUntil=0;note(outcome.detail?`Connection request rejected: ${outcome.detail}`:'Connection request rejected.')}await networkPage(true);if(r.ok&&outcome.accepted!==false)scheduleNetworkRefresh(false,true,true)};
  $('#networkConnect').onclick=submitNetworkConnect;
  const submitNetworkReconnect=async()=>{const button=$('#networkReconnect');if(!button||button.disabled)return;button.disabled=true;const r=await fetch('/network/reconnect',{method:'POST'});if(r.ok){networkConnectPendingUntil=Date.now()+15000;note('Reconnecting using the remembered network…')}else{networkConnectPendingUntil=0;note('Reconnect request rejected.')}await networkPage(true);if(r.ok)scheduleNetworkRefresh(false,true,true)};
  if($('#networkReconnect'))$('#networkReconnect').onclick=submitNetworkReconnect;
  $('#networkPassword').onkeydown=e=>{if(e.key==='Enter'){e.preventDefault();submitNetworkConnect(e)}};
  if($('#networkDisconnect'))$('#networkDisconnect').onclick=async()=>{const r=await fetch('/network/disconnect',{method:'POST'});note(r.ok?'Disconnected.':'Disconnect rejected.');await networkPage(true)};
  $('#networkForget').onclick=async()=>{if(!confirm('Forget the remembered external network?'))return;const r=await fetch('/network/forget',{method:'POST'});if(r.ok){networkDraftSsid='';networkDraftPassword='';networkDraftActive=false;ssidInput.value='';passwordInput.value=''}note(r.ok?'Network forgotten.':'Forget request rejected.');await networkPage(true)};
  scheduleNetworkRefresh(scanBusy,sta.state==='CONNECTING'||connectPending);
}
async function diagnosticsPage(){V='diagnostics';rememberView();viewPinned=true;let s;try{s=await G('/diag/status')}catch(e){s=null}const capability=s?.exportCapability||'UNAVAILABLE';const canControl=!!C?.hasMaster;const devLifecycle=Number(s?.developmentLifecycle||0);const active=devLifecycle===1||devLifecycle===2||devLifecycle===3;A.innerHTML=`<section class="hero"><div class="eye">ADVANCED · DIAGNOSTICS</div><h1>Diagnostics</h1></section><section class="card"><div class="status">${capability}</div><p class="muted">P&amp;P creates one support artifact from the available diagnostic evidence.</p><button class="btn primary" id="downloadDiagnostics" ${capability==='UNAVAILABLE'?'disabled':''}>DOWNLOAD DIAGNOSTICS</button><button class="btn" id="networkNav">NETWORK</button><h3>System Health</h3><p class="muted">${s?`Stored records: ${s.retainedRecords||0} · Storage: ${s.storageHealth}`:'Status unavailable'}</p><h3>Normal Diagnostics</h3><p class="muted">Always on · bounded · observation only</p>${canControl?`<h3>Development Diagnostics</h3><p class="muted">${active?'ACTIVE':'OFF'} · controlling SMUG only</p><button class="btn" id="developmentToggle">${active?'STOP':'START'} DEVELOPMENT LOGGING</button>`:''}</section>`;$('#networkNav').onclick=()=>networkPage();const download=$('#downloadDiagnostics');if(download)download.onclick=()=>{window.location.href='/diag/download'};const toggle=$('#developmentToggle');if(toggle)toggle.onclick=async()=>{const path=active?'/diag/session/stop':'/diag/session/start';await fetch(path,{method:'POST',headers:{'Content-Type':'application/json'},body:JSON.stringify({})});diagnosticsPage()}}async function practice(){if(practiceData){let r=practiceData;let rows=(r.entries||[]).map(e=>`<div class="result"><b>Racer ${e.mugId??'—'}</b><div>Lane ${e.lane}</div><div>${lapWord(e.laps)}</div><div>${sec(e.bestLap)}</div><div></div></div>`).join('');A.innerHTML=`<section class="hero"><div class="eye">PRACTICE SUMMARY</div><h1>Open Practice</h1><div class="muted">Session Fastest · ${sec(r.sessionFastestLap)}</div></section><section class="card">${rows}<div class="actions"><button class="btn primary" id="again">PRACTICE AGAIN</button><button class="btn" id="homePractice">HOME</button></div></section>`;$('#again').onclick=()=>req('/request/practice-again');$('#homePractice').onclick=()=>{practiceData=null;viewPinned=true;V='home';render()};return}try{let r=await G('/practice-summary');if(!r?.available){practiceData=null;V='home';return home()}practiceData=r;return practice()}catch(e){practiceData=null;V='home';return home()}}
async function details(){let key=selectedHistorySequence||0;if(detailsData&&detailsDataKey===key){return renderDetails(detailsData)}let q=selectedHistorySequence?`?sequence=${selectedHistorySequence}`:'';try{let d=await G('/details'+q);detailsData=d;detailsDataKey=key;renderDetails(d)}catch(e){detailsData=null;detailsDataKey=null;if(V==='details'){V='home';note('Details are unavailable.');home()}}}
function renderDetails(d){A.innerHTML=`<section class="hero"><div class="eye">DETAILS</div><h1>Completed Session</h1></section><section class="card">${(d.entries||[]).map(e=>`<p><b>Racer ${e.mugId??'-'} · Lane ${e.lane}</b> · ${(e.records||[]).map(x=>'Lap '+x.lapNumber+' '+sec(x.lapTime)).join(' · ')||'No valid laps'}</p>`).join('')}<div class="actions"><button class="btn" id="backResults">RESULTS</button><button class="btn" id="history">HISTORY</button></div></section>`;$('#backResults').onclick=()=>{V='results';render()};$('#history').onclick=()=>{historyData=null;V='history';render()}}
async function history(){if(historyData){return renderHistory(historyData)}try{let h=await G('/history');historyData=h;renderHistory(h)}catch(e){historyData=null;V='home';note('History is unavailable.');home()}}
function renderHistory(h){A.innerHTML=`<section class="hero"><div class="eye">HISTORY</div><h1>Completed Sessions</h1></section><section class="card">${(h.entries||[]).map(x=>`<button class="btn historyItem" data-sequence="${x.sequence}"><b>Race ${x.sequence} · ${name(x.mode)}</b> · ${x.mode==='ENDURANCE'?x.durationMinutes+' min':lapWord(x.lapTarget)}${(x.entries||[]).length?' · '+x.entries.map(e=>'Racer '+(e.mugId??'—')+' / Lane '+e.lane).join(' · '):''}</button>`).join('')||'<p>No completed races.</p>'}<div class="actions"><button class="btn" id="backResults">RESULTS</button></div></section>`;document.querySelectorAll('.historyItem').forEach(b=>b.onclick=()=>{selectedHistorySequence=Number(b.dataset.sequence);resultData=null;resultDataKey=null;V='results';render()});$('#backResults').onclick=()=>{selectedHistorySequence=null;resultData=null;resultDataKey=null;V='results';render()}}
function note(t){let n=$('#notice');n.textContent=t;n.classList.remove('hide');setTimeout(()=>n.classList.add('hide'),3000)}async function req(path,extra={},setup=false){let id=corr++,traceId=diagnosticTraceId();diagnosticAction(diagnosticOperationForPath(path),id,traceId);diagnosticPresentationTraceId=traceId;diagnosticPresentationCorrelation=id;diagnosticPresentationOperation=diagnosticOperationForPath(path);diagnosticPresentationTracePending=true;if((path==='/request/start'&&(setupRunning||setupDesired))||busy)return;busy=true;render();let body={correlationId:id,diagnosticTraceId:traceId,...extra};try{let r=await fetch(path,{method:'POST',headers:{'Content-Type':'application/json'},body:JSON.stringify(body)});if(r.status!==202)throw Error();await wait(id)}catch(e){busy=false;note('That action could not be completed.');await poll()}}async function wait(id){for(let i=0;i<50;i++){await new Promise(r=>setTimeout(r,100));let x=await G('/request-result?correlationId='+id);if(x){busy=false;if(x.result!=='ACCEPTED')note(x.reason||'P&P rejected that action.');await poll();return}}busy=false;note('P&P has not confirmed that action.');await poll()}function reportDisplayedLaps(v){if(!v||!Array.isArray(v.entries))return;for(const e of v.entries){const key=String(e.raceEntryId||e.lane);const lap=Number(e.laps||0);const previous=displayedLapByEntry[key];if(previous===undefined){displayedLapByEntry[key]=lap;continue}if(lap<=previous)continue;displayedLapByEntry[key]=lap;for(let n=previous+1;n<=lap;n++){const s=lastSseNotification&&Number(lastSseNotification.lapEntry)===Number(e.raceEntryId)&&Number(lastSseNotification.lap)===n?lastSseNotification:{};const t=activeLatencyTrace&&Number(activeLatencyTrace.entry)===Number(e.raceEntryId)&&Number(activeLatencyTrace.lap)===n?activeLatencyTrace:{};if(t&&t.renderStartedMs===undefined)t.renderStartedMs=performance.now();if(t)t.domUpdatedMs=performance.now();try{fetch('/diag/lap-displayed',{method:'POST',headers:{'Content-Type':'application/json'},body:JSON.stringify({lane:e.lane,entry:e.raceEntryId,lap:n,revision:Number(s.revision||revision||0),eventId:Number(s.eventId||0),serverUs:Number(t.serverUs||s.serverUs||0),sseReceivedMs:Number(t.sseReceivedMs||0),refreshStartedMs:Number(t.refreshStartedMs||0),stateStartMs:Number(t.stateStartMs||0),stateEndMs:Number(t.stateEndMs||0),proposalStartMs:Number(t.proposalStartMs||0),proposalEndMs:Number(t.proposalEndMs||0),contextStartMs:Number(t.contextStartMs||0),contextEndMs:Number(t.contextEndMs||0),appliedMs:Number(t.appliedMs||0),renderStartedMs:Number(t.renderStartedMs||0),domUpdatedMs:Number(t.domUpdatedMs||0)}),keepalive:true}).catch(()=>{})}catch(_){}activeLatencyTrace=null}}}function render(){if(!S||!P)return;$('#overlay').innerHTML='';header();if(S.finishDisplay?.active){race();reportDisplayedLaps(S);return}if(S.lifecycle==='PAUSED')return paused();if(['STARTING','RACING','RESTARTING'].includes(S.lifecycle)){race();reportDisplayedLaps(S);return}if(V==='practice')return practice();if(V==='diagnostics')return diagnosticsPage();if(V==='network')return networkPage();if(V==='details')return details();if(V==='history')return history();if(V==='results')return results();if(V==='setup')return setup();if(V==='track')return simpleView('Track Setup','Track setup is available from P&P configuration.');if(V==='racers')return simpleView('Racers','Racer management is available from P&P configuration.');if(V==='settings')return settingsPage();home()}async function readTimedState(trace,observation={}){const sent=performance.now();if(trace)trace.stateStartMs=sent;diagnosticObservation('state_fetch_started',observation);try{const value=await G('/state');diagnosticObservation('state_received',{...observation,lifecycle:value?.lifecycle||'',sessionMode:value?.sessionMode||''});return{value,sent,received:performance.now()}}finally{if(trace)trace.stateEndMs=performance.now()}}async function tracedGet(path,label,trace){const started=performance.now();if(trace)trace[label+'StartMs']=started;try{return await G(path)}finally{if(trace)trace[label+'EndMs']=performance.now()}}async function poll(trigger='bootstrap',notification=null){if(polling){pollDirty=true;return}const sseRefresh=trigger==='sse';const startedAt=performance.now();const trace=sseRefresh?activeLatencyTrace:null;const observation={traceId:Number(diagnosticPresentationTracePending?diagnosticPresentationTraceId:0),correlationId:Number(diagnosticPresentationTracePending?diagnosticPresentationCorrelation:0),revision:Number(notification?.revision||0),eventId:Number(notification?.eventId||0),reconstruction:trigger==='bootstrap'||trigger==='reconnect'||trigger==='recovery'};if(trace)trace.refreshStartedMs=startedAt;if(sseRefresh)console.log('[SSE] refresh_started revision='+(notification?.revision??'?')+' server_us='+(notification?.serverUs??'?')+' browser_ms='+startedAt.toFixed(1));polling=true;try{const activeBefore=!!(S&&(['STARTING','RACING','PAUSED','RESTARTING'].includes(S.lifecycle)||S.finishDisplay?.active));let timedS,nextP,nextC;if(activeBefore){timedS=await readTimedState(trace,observation)}else{[timedS,nextP,nextC]=await Promise.all([readTimedState(trace,observation),tracedGet('/proposal','proposal',trace),tracedGet('/context','context',trace)])}const nextS=timedS.value;const activeAfter=!!(nextS&&(['STARTING','RACING','PAUSED','RESTARTING'].includes(nextS.lifecycle)||nextS.finishDisplay?.active));if(activeBefore&&!activeAfter){[nextP,nextC]=await Promise.all([tracedGet('/proposal','proposal',trace),tracedGet('/context','context',trace)])}S=nextS;if(!selectedHistorySequence&&resultData&&resultDataKey===0&&Number(S?.historySequence||0)>Number(resultDataHistorySequence||0)){resultData=null;resultDataKey=null;resultDataHistorySequence=null}markSynchronised();diagnosticObservation('state_applied',{...observation,lifecycle:S?.lifecycle||'',sessionMode:S?.sessionMode||''});if(observation.reconstruction)diagnosticObservation('reconstruction',{...observation,lifecycle:S?.lifecycle||'',sessionMode:S?.sessionMode||''});if(nextP){applyProposal(nextP)}if(nextC){C=nextC}if(trace)trace.appliedMs=performance.now();const previous=lastLifecycle;if(previous!==null&&previous!==S.lifecycle&&S.lifecycle!=='FINISHED')viewPinned=false;if(previous===null||previous!==S.lifecycle){if(S.lifecycle==='FINISHED')viewPinned=false;lastLifecycle=S.lifecycle}if(!selectedHistorySequence&&S.lifecycle!=='FINISHED'&&!S.resultSealed){resultData=null;resultDataKey=null;detailsData=null;detailsDataKey=null;if(V==='results'||V==='details')V='home'}if(V==='practice'&&S.lifecycle==='READY'&&!S.practiceSummaryAvailable){practiceData=null;V='home'}if(!viewPinned&&S.practiceSummaryAvailable&&!selectedHistorySequence&&V!=='details'&&V!=='history')V='practice';else if(!viewPinned&&S.lifecycle==='FINISHED'&&!S.finishDisplay?.active&&!selectedHistorySequence&&!['details','history'].includes(V))V='results';const setupView=V==='setup'&&S.lifecycle==='READY';const proposalRevision=Number(P?.proposalRevision||0);const setupRevisionChanged=proposalRevision!==Number(setupRenderedRevision||0);const preserveSetup=setupView&&(setupRunning||setupDesired||!setupRevisionChanged);if(preserveSetup)header();else{if(trace)trace.renderStartedMs=performance.now();render();diagnosticObservation('rendered',{...observation,lifecycle:S?.lifecycle||'',sessionMode:S?.sessionMode||'',phase:S?.startPresentation?.phase||'NONE'});diagnosticPresentationTracePending=false}if(setupDesired&&!setupRunning)drainSetup();if(sseRefresh)console.log('[SSE] refresh_rendered revision='+(notification?.revision??'?')+' server_us='+(nextS?.systemTime??'?')+' browser_ms='+performance.now().toFixed(1))}catch(e){markOffline()}finally{polling=false;if(pollDirty){pollDirty=false;setTimeout(()=>poll('dirty'),0)}}}let eventStream=null;let eventStreamWatchdog=null;let eventStreamLivenessTimer=null;let eventStreamLastActivityMs=0;const eventStreamLivenessTimeoutMs=25000;function eventStreamIsOpen(){return !!eventStream&&typeof EventSource!=='undefined'&&eventStream.readyState===EventSource.OPEN}function retireEventStream(){const stream=eventStream;if(eventStreamWatchdog){clearTimeout(eventStreamWatchdog);eventStreamWatchdog=null}if(eventStreamLivenessTimer){clearTimeout(eventStreamLivenessTimer);eventStreamLivenessTimer=null}eventStream=null;eventStreamLastActivityMs=0;if(stream){try{stream.close()}catch(_){}}}function noteEventStreamActivity(stream){if(eventStream!==stream)return;eventStreamLastActivityMs=performance.now();if(eventStreamLivenessTimer)clearTimeout(eventStreamLivenessTimer);eventStreamLivenessTimer=setTimeout(()=>{if(eventStream!==stream||!eventStreamIsOpen())return;const age=performance.now()-eventStreamLastActivityMs;if(age<eventStreamLivenessTimeoutMs){noteEventStreamActivity(stream);return}markOffline();console.log('[SSE] liveness_timeout age_ms='+Math.round(age));retireEventStream();setTimeout(openEventStream,2000)},eventStreamLivenessTimeoutMs)}function openEventStream(){if(typeof EventSource==='undefined'){console.log('[SSE] unavailable');return}if(eventStreamIsOpen()||eventStream?.readyState===EventSource.CONNECTING)return;retireEventStream();try{console.log('[SSE] constructing /events');const stream=new EventSource('/events');eventStream=stream;eventStreamWatchdog=setTimeout(()=>{if(eventStream===stream&&!eventStreamIsOpen()){console.log('[SSE] connect_timeout readyState='+stream.readyState);retireEventStream();poll('recovery');setTimeout(openEventStream,2000)}},5000);stream.onopen=()=>{if(eventStream!==stream)return;if(eventStreamWatchdog){clearTimeout(eventStreamWatchdog);eventStreamWatchdog=null}noteEventStreamActivity(stream);console.log('[SSE] open readyState='+stream.readyState);poll('reconnect')};stream.onmessage=e=>{if(eventStream!==stream)return;noteEventStreamActivity(stream);let n=null;try{n=JSON.parse(e.data||'{}')}catch(_){}lastSseNotification=n;const receivedMs=performance.now();if(n?.lapEntry&&n?.lap){activeLatencyTrace={entry:Number(n.lapEntry),lap:Number(n.lap),eventId:Number(n.eventId||0),revision:Number(n.revision||0),serverUs:Number(n.serverUs||0),sseReceivedMs:receivedMs}}console.log('[SSE] received revision='+(n?.revision??'?')+' server_us='+(n?.serverUs??'?')+' browser_ms='+receivedMs.toFixed(1));diagnosticObservation('notification',{revision:Number(n?.revision||0),eventId:Number(n?.eventId||0)});if(typeof window.poll==='function')window.poll('sse',n);else poll('sse',n)};stream.addEventListener('heartbeat',e=>{if(eventStream!==stream)return;noteEventStreamActivity(stream)});stream.addEventListener('control',e=>{if(eventStream!==stream)return;noteEventStreamActivity(stream);poll('reconnect')});stream.addEventListener('presentation',e=>{if(eventStream!==stream)return;noteEventStreamActivity(stream);try{const v=JSON.parse(e.data||'{}');if(!S||S.lifecycle!==v.l||S.sessionMode!==v.m){poll('reconnect');return}S.remainingDuration=Number(v.r||0);S.overtime=Number(v.o||0);S.startPresentation=S.startPresentation||{};S.startPresentation.phase=v.p||'NONE';S.startPresentation.redLightsLit=Number(v.n||0);S.startPresentation.redLightCount=Number(v.c||0);S.startPresentation.green=!!v.g;S.startPresentation.active=S.startPresentation.phase!=='NONE';diagnosticObservation('notification',{phase:'PRESENTATION'});render();diagnosticObservation('rendered',{lifecycle:S.lifecycle,sessionMode:S.sessionMode,phase:S.startPresentation.phase});diagnosticPresentationTracePending=false}catch(_){} });stream.onerror=()=>{if(eventStream!==stream)return;markOffline();console.log('[SSE] error readyState='+stream.readyState);if(stream.readyState===EventSource.CLOSED){retireEventStream();setTimeout(openEventStream,2000)}}}catch(e){console.log('[SSE] construct_error '+e);retireEventStream();setTimeout(openEventStream,2000)}}$('#logo').onclick=()=>{viewPinned=true;V='home';render()};$('#setupNav').onclick=()=>{viewPinned=true;V='setup';render()};$('#resultsNav').onclick=()=>{viewPinned=true;selectedHistorySequence=null;resultData=null;resultDataKey=null;V='results';render()};$('#trackNav').onclick=()=>{viewPinned=true;V='track';render()};$('#racersNav').onclick=()=>{viewPinned=true;V='racers';render()};$('#settingsNav').onclick=()=>{viewPinned=true;V='settings';render()};function bootstrapDiagnostic(step){try{fetch('/diag/bootstrap?step='+encodeURIComponent(step),{cache:'no-store',keepalive:true}).catch(()=>{})}catch(_){} }bootstrapDiagnostic('script');restoreView();poll();bootstrapDiagnostic('eventsource');openEventStream();setInterval(()=>{if(!eventStreamIsOpen()){if(eventStream&&eventStream.readyState!==EventSource.CONNECTING)retireEventStream();openEventStream();poll('recovery')}},15000);let retryStoragePending=false;const baseDiagnosticsPage=diagnosticsPage;async function retryStorage(){if(retryStoragePending)return;const health=Number(document.querySelector('[data-storage-health]')?.dataset.storageHealth||0);const eligible=(health===2||health===3)&&C?.isMaster===true&&['READY','FINISHED'].includes(S?.lifecycle);if(!eligible){note('Retry storage is not available in the current state.');return}retryStoragePending=true;const button=$('#retryStorage');if(button){button.disabled=true;button.textContent='REQUESTING…'}try{const response=await fetch('/request/retry-storage',{method:'POST',headers:{'Content-Type':'application/json'},body:'{}'});let body={};try{body=await response.json()}catch(_){}if(response.status===202&&body.accepted===true)note('Storage recovery requested; awaiting authoritative health.');else note(body.reason||'Retry storage request was rejected.')}catch(_){note('Retry storage request failed.')}finally{retryStoragePending=false;await diagnosticsPage()}}diagnosticsPage=async function(){await baseDiagnosticsPage();let status=null;try{status=await G('/diag/status')}catch(_){}const physical=String(status?.physicalStorage||'UNKNOWN');const physicalUnavailable=physical!=='HEALTHY'&&physical!=='MOUNTED';const history=String(status?.historyHealth||'UNKNOWN');const historyDegraded=history==='CORRUPT'||history==='UNSUPPORTED'||history==='DEGRADED';const card=document.querySelector('.card');if(!card||(!physicalUnavailable&&!historyDegraded))return;const host=document.createElement('div');host.dataset.storageHealth=String(status?.storageHealth||0);host.innerHTML=physicalUnavailable?'<h3>Storage Recovery</h3><p class="muted">Storage is unavailable. Recovery is available to the controlling Race Director when the race is settled.</p><button class="btn primary" id="retryStorage">RETRY STORAGE</button>':'<h3>History Integrity</h3><p class="muted">History is degraded or corrupt. Valid records remain available; Retry storage does not repair History integrity.</p>';card.appendChild(host);const button=host.querySelector('#retryStorage');if(!button)return;const eligible=C?.isMaster===true&&['READY','FINISHED'].includes(S?.lifecycle)&&!retryStoragePending;button.disabled=!eligible||retryStoragePending;if(!eligible)button.title='Only the controlling Race Director may retry storage while READY or FINISHED';if(retryStoragePending)button.textContent='REQUESTING…';button.onclick=retryStorage};let updateSelectedFile=null,updateUiBusy=false,updateUiMessage='';
function updateStateLabel(s){return({IDLE:'Ready',RECEIVING_STAGING:'Uploading',VALIDATING:'Checking update',CANDIDATE_READY:'Ready to install',INSTALLING_PENDING_BOOT:'Installing',AWAITING_HEALTH_CONFIRMATION:'Confirming update',COMMITTED:'Update complete',KNOWN_GOOD_RESTORED:'Previous firmware restored',RECOVERY_REQUIRED:'Support recovery required',FAILED:'Update failed'})[s]||s||'Unknown'}
function updateReasonText(r){return({CONTROLLING_RACE_DIRECTOR_REQUIRED:'Only the controlling Race Director can update P&P.',LIFECYCLE_NOT_SETTLED:'Updates are available only when the race is settled.',UPDATE_ALREADY_IN_PROGRESS:'An update is already in progress.',INVALID_REQUEST:'Choose a complete firmware file and try again.',IMAGE_TOO_LARGE:'That firmware file is too large for P&P.',INCOMPLETE_UPLOAD:'The upload was interrupted. The current firmware is unchanged.',UNAUTHENTICATED:'P&P could not verify that firmware file.',INCOMPATIBLE_TARGET:'That firmware is not for this P&P controller.',DOWNGRADE_REJECTED:'Older firmware cannot be installed through the customer update path.',INTEGRITY_FAILURE:'The firmware file is damaged or incomplete.',INVALID_CANDIDATE:'P&P could not validate that firmware file.',UPDATE_NOT_READY:'The update is not ready for this step.',UPDATE_REJECTED:'P&P rejected the update request.'})[r]||'The update could not be completed.'}
function updateRecoveryMessage(s){if(s==='KNOWN_GOOD_RESTORED')return'Update failed. The previous firmware was restored.';if(s==='RECOVERY_REQUIRED')return'Update could not be recovered automatically. Contact support.';if(s==='COMMITTED')return'Update complete. P&P is running the new firmware.';return''}
function updateStatusText(status){const recovery=updateRecoveryMessage(status?.state);return recovery||updateUiMessage||updateStateLabel(status?.state)}
function updateSettingsRender(current,status){const canControl=C?.isMaster===true&&['READY','FINISHED'].includes(S?.lifecycle);const active=['RECEIVING_STAGING','VALIDATING','CANDIDATE_READY','INSTALLING_PENDING_BOOT','AWAITING_HEALTH_CONFIRMATION'].includes(status?.state);const fileName=updateSelectedFile?updateSelectedFile.name:'No file selected';const fileSize=updateSelectedFile?` · ${updateSelectedFile.size} bytes`:'';const candidateReady=status?.state==='CANDIDATE_READY';const failure=status?.validationFailure&&status.validationFailure!=='NONE'?updateReasonText(status.validationFailure):'';const recovery=updateRecoveryMessage(status?.state);A.innerHTML=`<section class="hero"><div class="eye">SETTINGS</div><h1>Settings</h1></section><section class="card"><h2>Firmware</h2><p class="muted">Current firmware: ${current?.firmwareBuild||'Unknown'}${current?.buildEnvironment?' · '+current.buildEnvironment:''}</p><p class="muted">Update state: ${updateStatusText(status)}</p>${failure?`<p class="muted">${failure}</p>`:''}${recovery?`<p class="muted">${recovery}</p>`:''}<input id="updateFile" type="file" accept=".bin,application/octet-stream" ${active?'disabled':''}><p class="muted">${fileName}${fileSize}</p><div class="actions"><button class="btn primary" id="updateBegin" ${!updateSelectedFile||active||!canControl?'disabled':''}>UPDATE P&amp;P</button>${candidateReady?'<button class="btn primary" id="updateInstall">INSTALL AND RESTART</button>':''}</div>${!canControl?'<p class="muted">Only the controlling Race Director can update P&amp;P while the race is settled.</p>':''}<p id="updateProgress" class="muted">${updateUiBusy?'Uploading…':''}</p><div class="actions"><button class="btn" id="diagnosticsNav">Diagnostics</button></div></section>`;const input=$('#updateFile');if(input)input.onchange=()=>{updateSelectedFile=input.files&&input.files[0]?input.files[0]:null;updateSettingsRender(current,status)};const begin=$('#updateBegin');if(begin)begin.onclick=()=>updateBegin(current);const install=$('#updateInstall');if(install)install.onclick=()=>updateInstall();const diag=$('#diagnosticsNav');if(diag)diag.onclick=()=>diagnosticsPage()}
async function updateReadStatus(){try{return await G('/update/status')}catch(_){return{state:'FAILED'}}}
async function settingsPage(){V='settings';rememberView();let current=null,status=null;try{current=await G('/health')}catch(_){}status=await updateReadStatus();updateSettingsRender(current,status)}
async function updateBegin(current){if(updateUiBusy||!updateSelectedFile)return;if(!C?.isMaster||!['READY','FINISHED'].includes(S?.lifecycle)){updateUiMessage=updateReasonText('LIFECYCLE_NOT_SETTLED');return settingsPage()}if(!window.confirm('Install this firmware update and restart P&P?'))return;updateUiBusy=true;updateUiMessage='';updateSettingsRender(current,{state:'RECEIVING_STAGING'});try{const begin=await fetch('/request/update/begin',{method:'POST',headers:{'Content-Type':'application/json'},body:JSON.stringify({size:updateSelectedFile.size})});let body={};try{body=await begin.json()}catch(_){}if(!begin.ok||body.accepted!==true)throw Error(body.reason||'UPDATE_REJECTED');const upload=await new Promise((resolve,reject)=>{const xhr=new XMLHttpRequest();xhr.open('POST','/request/update/upload');xhr.upload.onprogress=e=>{const p=e.lengthComputable?Math.round(e.loaded*100/e.total):0;const el=$('#updateProgress');if(el)el.textContent='Uploading… '+p+'%'};xhr.onload=()=>{let value={};try{value=JSON.parse(xhr.responseText||'{}')}catch(_){}xhr.status>=200&&xhr.status<300&&value.accepted===true?resolve(value):reject(Error(value.reason||'INCOMPLETE_UPLOAD'))};xhr.onerror=()=>reject(Error('INCOMPLETE_UPLOAD'));xhr.onabort=()=>reject(Error('INCOMPLETE_UPLOAD'));xhr.send(updateSelectedFile)});if(!upload)throw Error('INCOMPLETE_UPLOAD');const validation=await fetch('/request/update/validate',{method:'POST',headers:{'Content-Type':'application/json'},body:'{}'});let result={};try{result=await validation.json()}catch(_){}if(!validation.ok||result.accepted!==true)throw Error(result.reason||'INVALID_CANDIDATE');updateUiMessage='The update is ready to install.';updateSelectedFile=null}catch(error){updateUiMessage=updateReasonText(error.message)}finally{updateUiBusy=false;await settingsPage()}}
async function updateInstall(){if(updateUiBusy)return;if(!window.confirm('Install the validated update and restart P&P now?'))return;updateUiBusy=true;try{const response=await fetch('/request/update/install',{method:'POST',headers:{'Content-Type':'application/json'},body:'{}'});let body={};try{body=await response.json()}catch(_){}if(!response.ok||body.accepted!==true)updateUiMessage=updateReasonText(body.reason||'UPDATE_REJECTED');else updateUiMessage='P&P is restarting with the update.'}catch(_){updateUiMessage='The update could not be started. The current firmware is unchanged.'}finally{updateUiBusy=false;updateSettingsRender(null,await updateReadStatus())}}
let devOpen=false,devFact=null,devNotice=null,devHealth=null,devHealthTick=0;function devVal(v){return v===undefined||v===null||v===''?'—':v}function devGap(e){if(e.gapKind==='TIME')return`+${(+e.gapTimeUs/1e6).toFixed(2)} s`;if(e.gapKind==='LAPS')return`+${+e.gapLaps} L`;return'—'}function devPairs(x){return x.map(([a,b])=>`<span>${a}</span><b>${devVal(b)}</b>`).join('')}function renderDev(){if(!devOpen)return;let sp=S?.startPresentation||{},fd=S?.finishDisplay||{};$('#devState').innerHTML=devPairs([['Lifecycle',S?.lifecycle],['Active mode',S?.sessionMode],['Proposed mode',P?.mode],['Proposal revision',P?.proposalRevision],['Startable',P?.startable?'YES':'NO'],['Readiness',P?.readinessContext?.code||P?.readiness],['Start phase',sp.phase],['Red lamps',sp.redLightsLit===undefined?'—':`${sp.redLightsLit} / ${sp.redLightCount}`],['Start active',sp.active?'YES':'NO'],['Remaining',S?.sessionMode==='ENDURANCE'?clock(S.remainingDuration):'—'],['Duration expired',S?.durationExpired?'YES':'NO'],['Overtime',S?.overtime?sec(S.overtime):'—'],['Finish Display',fd.active?'ACTIVE':'OFF'],['Result',S?.resultSealed?(S?.resultValid?'SEALED · VALID':'SEALED · INVALID'):'OPEN'],['Persistence',S?.persistenceFault?'FAULT':S?.persistencePending?'PENDING':'OK'],['History sequence',S?.historySequence||'—'],['Race Director',C?.isMaster?'THIS BROWSER':C?.hasMaster?'OTHER':'NONE']]);let entries=S?.lifecycle&&S.lifecycle!=='READY'?(S.entries||[]):[];$('#devLanes').innerHTML=entries.length?entries.map(e=>`<div class="devlane"><b>L${e.lane} · Racer ${e.mugId??'—'}</b><div class="devkv">${devPairs([['Laps',e.classifiedLaps],['Position',e.position||'—'],['GAP',devGap(e)],['Last',sec(e.lastLapTime)],['Best',sec(e.bestLapTime)],['Timing origin',e.waitingForTimingOrigin?'WAITING':e.hasLap?'SET':'—']])}</div></div>`).join(''):(P?.entries||[]).map(e=>`<div class="devlane"><b>L${e.lane} · Racer ${e.mugId??'—'}</b><div class="devkv">${devPairs([['Input device',e.inputDevice],['Capability',e.inputCapability]])}</div></div>`).join('');if(devFact)$('#devFact').textContent='Latest fact · '+(devFact.type||'NONE')+(devFact.type==='LAP_COMPLETED'?` · Entry ${devFact.raceEntryId} · Lap ${devFact.lapNumber} · ${sec(devFact.lapTime)}`:'');if(devHealth){$('#devHealth').innerHTML=devPairs([['Health',devHealth.ok===false?'FAULT':'OK'],['Wi-Fi',devHealth.wifiConnected===false?'Disconnected':'Connected'],['HTTP',devHealth.serverReady===false?'Stopped':'Running'],['Requests',`${devHealth.requestCount??'—'} · Errors ${devHealth.requestErrors??'—'}`],['Last',`${devHealth.lastRoute??'—'} · ${devHealth.lastDurationMs??'—'} ms`],['Storage',S?.persistenceFault?'FAULT':S?.persistencePending?'PENDING':'OK'],['Noticeboard',devNotice?.revision],['Proposal rev',devNotice?.proposalRevision]]);$('#devHealthMore').innerHTML=devPairs([['Reconnects',devHealth.reconnectAttempts],['Slow requests',devHealth.slowRequests],['Peak handlers',devHealth.peakHandlers],['Server starts',devHealth.serverStarts],['Server stops',devHealth.serverStops]])}}async function devPoll(){if(!devOpen)return;try{let [f,n]=await Promise.all([G('/fact'),G('/noticeboard')]);devFact=f;devNotice=n;if(++devHealthTick%2===1)devHealth=await G('/health');renderDev()}catch(e){if(devOpen)$('#devHealth').innerHTML='<span>Diagnostics</span><b>Unavailable</b>'}}function setDev(open){devOpen=open;document.body.classList.toggle('devopen',open);$('#devDrawer').classList.toggle('hide',!open);$('#devTab').classList.toggle('hide',open);if(open){renderDev();devPoll()}}async function devPass(lane){let r=await fetch('/fixture',{method:'POST',headers:{'Content-Type':'application/json'},body:JSON.stringify({action:'lane'+lane})});let text='';try{text=await r.text()}catch(e){}$('#devFixture').textContent=r.ok?`L${lane} passage accepted`:r.status===404?'Test inputs unavailable in this build':`Rejected · ${text||r.status}`;if(devOpen)renderDev()}$('#devTab').onclick=()=>setDev(true);$('#devClose').onclick=()=>setDev(false);$('#devL1').onclick=()=>devPass(1);$('#devL2').onclick=()=>devPass(2);setInterval(devPoll,1000);</script>
)PPHTML";
